/*
 * ============================================================================
 * ESP32 Control ESP-NOW - Wireless Controller with Franzininho WiFi (ESP32-S2)
 * ============================================================================
 *
 * DESCRIPTION:
 * This sketch implements a wireless remote controller using ESP-NOW protocol.
 * It communicates with a robot receiver to control movement with variable speed.
 * Displays real-time status on an OLED screen including signal strength (RSSI)
 * and connection state.
 *
 * HARDWARE:
 * - Franzininho WiFi (ESP32-S2)
 * - 6 buttons (directional pad + speed control)
 * - SSD1306 OLED display (128x64) connected via I2C
 *
 * BUTTON MAPPING:
 * - UP, DOWN, LEFT, RIGHT: Movement control
 * - Button A: Increase speed
 * - Button B: Decrease speed
 *
 * COMMUNICATION:
 * - Protocol: ESP-NOW (peer-to-peer WiFi)
 * - Reliability: Automatic retransmission with ESPNowProtocol library
 * - Message Types: Control commands and telemetry reception
 * - Auto-discovery: Enabled for automatic peer detection
 *
 * DEPENDENCIES:
 * - ESPNowProtocol (GitHub: https://github.com/FBSeletronica/ESPNowProtocol)
 * - Adafruit_SSD1306 (OLED display driver)
 * - Adafruit_GFX (Graphics library)
 * - Adafruit_BusIO (I2C/SPI abstraction)
 *
 * AUTHOR: Fabio Souza
 * LICENSE: MIT License
 * VERSION: 1.2
 * 
 * ============================================================================
 */

#include <ESPNowProtocol.h>
#include <Wire.h>
#include <Adafruit_GFX.h>
#include <Adafruit_SSD1306.h>

// ============================================================================
// HARDWARE CONFIGURATION
// ============================================================================

// OLED Display (SSD1306) - I2C Configuration
// Connect SDA and SCL lines to the pins defined below

#define OLED_SDA 8
#define OLED_SCL 9

#define SCREEN_WIDTH 128
#define SCREEN_HEIGHT 64

Adafruit_SSD1306 display(SCREEN_WIDTH, SCREEN_HEIGHT, &Wire, -1);

// ============================================================================
// DISPLAY ASSETS
// ============================================================================

// Franzininho splash screen bitmap - displayed at startup
// Dimensions: 128x64 pixels, stored in PROGMEM (flash memory)
#define imageWidth 128
#define imageHeight 64

const unsigned char franzininho_logo_128x64 [] PROGMEM = {                                      
  0xff, 0xff, 0xff, 0xff, 0xff, 0xff, 0xff, 0xff, 0xff, 0xff, 0xff, 0xff, 0xff, 0xff, 0xff, 0xff, 
  0xff, 0xff, 0xff, 0xff, 0xff, 0xff, 0xff, 0xff, 0xff, 0xff, 0xff, 0xff, 0xff, 0xff, 0xff, 0xff, 
  0xff, 0xff, 0xff, 0xff, 0xff, 0xff, 0xff, 0xff, 0xff, 0xff, 0xff, 0xff, 0xff, 0xff, 0xff, 0xff, 
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  0xff, 0xff, 0xff, 0xff, 0xff, 0xff, 0xff, 0xff, 0xff, 0xff, 0xff, 0xff, 0xff, 0xff, 0xff, 0xff
};

// ============================================================================
// CONTROL BUTTONS & I/O
// ============================================================================

// Button GPIO assignments (active LOW - internal pullup enabled)
#define BOTAO_UP    7
#define BOTAO_LEFT  6
#define BOTAO_RIGHT 5
#define BOTAO_DOWN  4
#define BOTAO_A     2
#define BOTAO_B     3

// ============================================================================
// ESP-NOW PROTOCOL CONFIGURATION
// ============================================================================

// Message type identifiers for ESP-NOW communication
// MSG_CONTROL: Movement commands sent to robot
// MSG_TELEMETRY: Status updates received from robot
#define MSG_CONTROL    1
#define MSG_TELEMETRY  2

// Drive commands - movement modes
// These commands are sent to control robot movement
#define CMD_STOP      0
#define CMD_FORWARD   1
#define CMD_BACKWARD  2
#define CMD_LEFT      3
#define CMD_RIGHT     4

// ============================================================================
// PROTOCOL DATA STRUCTURES
// ============================================================================

// Control payload structure sent over ESP-NOW
// Contains movement command and speed level
typedef struct {
  uint8_t cmd;      // Movement command (CMD_*)
  uint8_t speed;    // Speed level (MIN_SPEED to MAX_SPEED)
} control_t;

// ESP-NOW protocol instance
// Manages wireless communication using the ESPNowProtocol library
ESPNowProtocol protocol;

// ============================================================================
// WIRELESS PEER CONFIGURATION
// ============================================================================

// Node IDs for ESP-NOW communication
#define CONTROLLER_ID 1  // This device (controller)
#define ROBOT_ID      2  // Target device (robot receiver)

// ============================================================================
// SPEED CONTROL PARAMETERS
// ============================================================================

const int MIN_SPEED = 50;      // Minimum motor speed
const int MAX_SPEED = 200;     // Maximum motor speed
const int SPEED_STEP = 10;     // Speed increment/decrement step

// ============================================================================
// APPLICATION STATE VARIABLES
// ============================================================================

int speed = MIN_SPEED;                // Current speed setting
bool lastButtonAState = HIGH;         // Previous state of speed-up button
bool lastButtonBState = HIGH;         // Previous state of speed-down button

uint8_t lastCmdSent = 255;           // Last command transmitted
int lastSpeedSent = -1;               // Last speed value transmitted

int8_t lastRSSI = 0;                 // Signal strength indicator
bool linkOk = false;                  // Connection status flag

unsigned long lastPacketTime = 0;    // Timestamp of last received packet
unsigned long lastSendTime = 0;      // Timestamp of last sent command

// Communication timing parameters
#define LINK_TIMEOUT 3000   // Lost connection timeout (ms)
#define SEND_INTERVAL 100   // Minimum interval between commands (ms)

// ============================================================================
// UTILITY FUNCTIONS
// ============================================================================

/**
 * getCommandName()
 * 
 * Converts a movement command ID to a human-readable string
 * for display on the OLED screen.
 * 
 * @param cmd Command ID (CMD_*)
 * @return String representation of the command
 */
String getCommandName(uint8_t cmd)
{
  switch(cmd)
  {
    case CMD_FORWARD: return "FWD";
    case CMD_BACKWARD: return "BACK";
    case CMD_LEFT: return "LEFT";
    case CMD_RIGHT: return "RIGHT";
    default: return "STOP";
  }
}

// ============================================================================
// DISPLAY FUNCTIONS
// ============================================================================

/**
 * drawDisplay()
 * 
 * Updates the OLED display with current controller status:
 * - Operating mode
 * - Current movement command
 * - Current speed setting
 * - Signal strength (RSSI)
 * - Wireless connection status
 * 
 * Called continuously from main loop to keep display current.
 */
{
  display.clearDisplay();

  display.setTextSize(1);
  display.setCursor(0,0);
  display.print("MODE: DRIVE");

  display.setCursor(0,15);
  display.print("CMD: ");
  display.print(getCommandName(lastCmdSent));

  display.setCursor(0,30);
  display.print("SPD: ");
  display.print(lastSpeedSent);

  display.setCursor(0,45);
  display.print("RSSI: ");
  display.print(lastRSSI);

  display.setCursor(0,55);
  display.print("LINK: ");
  display.print(linkOk ? "OK" : "LOST");

  display.display();
}

// ============================================================================
// COMMUNICATION FUNCTIONS
// ============================================================================

/**
 * onData()
 * 
 * Callback function invoked when telemetry is received from the robot.
 * Updates link quality indicators and timestamp for connection monitoring.
 * 
 * This function is registered with ESPNowProtocol::onReceive() during setup.
 * 
 * @param src       Source MAC address (robot)
 * @param id        Message ID (MSG_TELEMETRY)
 * @param data      Pointer to telemetry payload
 * @param len       Length of telemetry data
 * @param rssi      Received signal strength indicator (-dBm)
 */
{
  if (id == MSG_TELEMETRY)
  {
    lastRSSI = rssi;
    lastPacketTime = millis();
    linkOk = true;
  }
}

/**
 * sendCommand()
 * 
 * Transmits movement command to the robot via ESP-NOW.
 * Uses ESPNowProtocol::sendReliable() for guaranteed delivery with retransmission.
 * 
 * Optimization: Avoids sending identical commands sent recently to reduce traffic.
 * 
 * @param cmd    Movement command (CMD_*)
 * @param speed  Speed level (MIN_SPEED to MAX_SPEED)
 */
{
  // Skip repeated transmissions that happen too quickly.
  if (cmd == lastCmdSent &&
      millis() - lastSendTime < SEND_INTERVAL)
    return;

  control_t ctrl;
  ctrl.cmd = cmd;
  ctrl.speed = speed;

  protocol.sendReliable(ROBOT_ID, MSG_CONTROL, (uint8_t*)&ctrl, sizeof(ctrl));

  Serial.print("CMD: ");
  Serial.print(cmd);
  Serial.print(" | Speed: ");
  Serial.println(speed);

  lastCmdSent = cmd;
  lastSpeedSent = speed;
  lastSendTime = millis();
}

// ============================================================================
// INITIALIZATION & MAIN LOOP
// ============================================================================

/**
 * setup()
 * 
 * Initializes hardware and wireless communication:
 * 1. Serial communication for debugging
 * 2. I2C bus for OLED display
 * 3. OLED display with Franzininho logo splash screen
 * 4. GPIO pins for button inputs (INPUT_PULLUP mode)
 * 5. ESPNowProtocol with auto-discovery enabled
 * 6. Telemetry callback registration
 * 
 * Runs once at device startup.
 */
{
  Serial.begin(115200);

  Wire.begin(OLED_SDA, OLED_SCL);

  display.begin(SSD1306_SWITCHCAPVCC, 0x3C);
  display.setTextColor(WHITE);

  // Show the Franzininho logo before entering controller mode.
  display.clearDisplay();
  display.drawBitmap(0, 0, franzininho_logo_128x64, imageWidth, imageHeight, WHITE);
  display.display();
  delay(2000);

  display.clearDisplay();
  display.display();

  pinMode(BOTAO_UP, INPUT_PULLUP);
  pinMode(BOTAO_LEFT, INPUT_PULLUP);
  pinMode(BOTAO_RIGHT, INPUT_PULLUP);
  pinMode(BOTAO_DOWN, INPUT_PULLUP);
  pinMode(BOTAO_A, INPUT_PULLUP);
  pinMode(BOTAO_B, INPUT_PULLUP);

  protocol.begin();
  protocol.setNodeId(CONTROLLER_ID);

  protocol.enableAutoDiscovery(true);
  protocol.onReceive(onData);

  Serial.println("Controller ready (v1.1 clean)");
}

/**
 * loop()
 * 
 * Main control loop - runs continuously:
 * 
 * 1. Process ESP-NOW events (protocol.loop())
 * 2. Read button inputs (directional pad + speed buttons)
 * 3. Update speed level based on button A/B presses
 * 4. Determine current movement command based on directional buttons
 * 5. Send command to robot if changed or interval elapsed
 * 6. Monitor connection timeout (marks link lost after 3s without telemetry)
 * 7. Update OLED display
 * 8. Small delay to prevent overload (20ms, ~50Hz update rate)
 * 
 * Timing:
 * - Command transmission: minimum 100ms between updates
 * - Connection timeout: 3000ms (3 seconds)
 * - Display refresh: ~50Hz (20ms loop time)
 */
{
  protocol.loop();

  // Read button inputs (active LOW due to internal pullup)
  // Each button will be LOW when pressed, HIGH when released
  bool down  = digitalRead(BOTAO_DOWN) == LOW;
  bool left  = digitalRead(BOTAO_LEFT) == LOW;
  bool right = digitalRead(BOTAO_RIGHT) == LOW;
  bool buttonA = digitalRead(BOTAO_A) == LOW;
  bool buttonB = digitalRead(BOTAO_B) == LOW;

  // Speed adjustment: detect rising edge (button press) only
  // Increment speed when Button A is pressed
  {
    speed += SPEED_STEP;
    if (speed > MAX_SPEED)
    {
      speed = MAX_SPEED;
    }
  }

  if (buttonB && lastButtonBState == HIGH)
  {
    // Decrement speed when Button B is pressed
    if (speed < MIN_SPEED)
    {
      speed = MIN_SPEED;
    }
  }

  lastButtonAState = buttonA ? LOW : HIGH;
  lastButtonBState = buttonB ? LOW : HIGH;

  // Determine movement command based on directional pad
  // Priority: UP > DOWN > LEFT > RIGHT
  // (only one direction can be active at a time)

  if (up) currentCmd = CMD_FORWARD;
  else if (down) currentCmd = CMD_BACKWARD;
  else if (left) currentCmd = CMD_LEFT;
  else if (right) currentCmd = CMD_RIGHT;

  sendCommand(currentCmd, speed);

  // Connection monitoring: if no telemetry received within timeout, mark link lost
  // This allows the display to show "LINK: LOST" when robot is unreachable
  if (millis() - lastPacketTime > LINK_TIMEOUT)
  {
    linkOk = false;
  }

  drawDisplay();

  delay(20);
}
